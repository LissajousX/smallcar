## esp32_cam/CameraWebServer/sdkconfig.defaults
```kconfig
# 禁用 Task Watchdog，防止 OTA 时 Flash 擦除超时导致系统重启
CONFIG_ESP_TASK_WDT=n
CONFIG_ESP_TASK_WDT_INIT=n
CONFIG_ESP_TASK_WDT_CHECK_IDLE_TASK_CPU0=n
CONFIG_ESP_TASK_WDT_CHECK_IDLE_TASK_CPU1=n

# 如果需要保留 Task Watchdog，增大超时时间
# CONFIG_ESP_TASK_WDT=y
# CONFIG_ESP_TASK_WDT_TIMEOUT_S=60
```
